;
; DA1B.asm
;
; Created: 9/20/2019 10:18:10 PM
; Author : ANDREW BUCHANAN
.equ STARTADDS = 0x0200		; STARTADDS
.equ FIVESTART = 0x0300		; 5 DIVIDES GO INTO 0X0300
.equ NONFIVESTART = 0x0500	; EVERYTHINGELSE GOES TO 0X0500
ldi	ZL, LOW(STARTADDS)		; 
ldi ZH, HIGH(STARTADDS)		; Z EQUALS 0X200
ldi R20, 0x5				; START AT 5
ldi R21, 0xFA				; COUNT 250 VALUES
; FIRST THE PROGRAM FILLS THE VALUES TO BE TESTED
FILL:						; FILL THE 0X0200'S WITH 250 VALUES
st	Z+, R20					; R20 INTO Z AND INCREMENT Z
inc R20						; INCREMENT R20 BY 1
dec	R21						; DECREMENT R21
brne FILL       			; IF R21 DOES NOT EQUAL 0 LOOP TO FILL 
;LOAD THE POINTERS TO THE RIGHT VALUES
ldi	ZL, LOW(STARTADDS)		; 
ldi ZH, HIGH(STARTADDS)		; Z EQUALS 0X200
ldi YL, LOW(FIVESTART)		; 
ldi YH, HIGH(FIVESTART)		; Y EQUALS 0X0300
ldi XL, LOW(NONFIVESTART)	; 
ldi XH, HIGH(NONFIVESTART)	; X EQUALS 0X0500
;LOAD 0 INTO THE FINAL SUM REGISTERS
ldi R16, 0					; MAKE SUM REGISTER EQUAL ZERO
ldi R17, 0					; MAKE SUM REGISTER EQUAL ZERO
ldi R18, 0					; MAKE SUM REGISTER EQUAL ZERO
ldi R19, 0					; MAKE SUM REGISTER EQUAL ZERO
ldi R20, 249				; MAKE R20  249 BECAUSE WE START THE COUNT AT 0
ldi R23, 0					; MAKE CARRY REGISTER EQUAL ZERO
;START THE LOOP TO SPLIT THE VALUES INTO THE TWO REGISTER LOCATIONS
SPLIT_LOOP:					;THIS LOOP CHECKS THE VALUE AND DECIDES WHICH MEMORY GROUP TO SEND THE VALUE
ld	R21, Z+					; LOADS THE VALUE IN THE 0X0200'S SPOT INTO R21
mov	R22, R21				; MAKES R22 EQUAL TO R21 FOR TESTING THE DIVISION WITHOUT CHANGING THE ORIGINAL NUMBER
FIVES_SEPERATE:				;THIS LOOP CHECKS IF THE NUMBER IS DIVISABLE BY 5
subi R21, 0x05				; SUBTRACT 5 FROM THE TEST NUMBER
breq DIVI					; IF THE NUMBER EQUALS 0 THEN IT IS DIVISABLE BY 5 GOT TO DIVI
brsh FIVES_SEPERATE			; IF THE NUMBER SUBTRACTED EQUALS 5 OR LARGER SUBTRACT AGAIN
;IF THE LOOP BREAKS THEN THE NUMBER IS NOT DIVISABLE BY 5
st	X+, R22					; STORE VALUE IN THE NON-FIVES SECTION OF REGISTERS
add	R18, R22				; ADD NEW VALUE TO STACK OF NON-FIVES SUMMED VALUES
adc	R19, R23				; ADD THE CARRY TO THE STACK OF CARRIES
;AFTER ADDING TO THE SUM, THE LOOP THEN SKIPS THE PART WHERE THE DIVISIBLE BY 5 NUMBERS ARE LOADED
rjmp IHOP					; JUMP DOWN TO IHOP TO CONTINUE SEPERATING ANOTHER NUMBER
; IF THE FIVES_SEPERATE LOOP BRANCHES TO DIVI THEN IT IS DIVISABLE BY FIVE
DIVI:						;DIVI STORES THE VALUE AND ADDS THE VALUE TO THE THE SUM FOR THE DIVISABLE BY FIVE NUMBERS
st	Y+, R22					; STORE VALUE IN THE FIVES SECTION OF REGISTERS
add	R16, R22				; ADD NEW VALUE TO STACK OF FIVES SUMED VALUES
adc	R17, R23				; ADD THE CARRY TO THE STACK OF CARRIES

IHOP:
dec	R20						; DECREMENT FROM 249 TO GO THROUGH ALL 250 NUMBERS
brne SPLIT_LOOP				; WHEN R20 EQUALS 0 BREAK LOOP

END: jmp END				; JUMP TO END
